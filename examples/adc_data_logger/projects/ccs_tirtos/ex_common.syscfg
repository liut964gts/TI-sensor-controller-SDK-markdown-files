/**
 * @cliArgs --board "/ti/boards/CC26X2R1_LAUNCHXL" --rtos tirtos7 --product "simplelink_cc13xx_cc26xx_sdk@8.30.01.01"
 */

/**
 * Import the modules used in this configuration.
 */
const GPIO  = scripting.addModule("/ti/drivers/GPIO");
const GPIO1 = GPIO.addInstance();
const GPIO2 = GPIO.addInstance();
const GPIO3 = GPIO.addInstance();
const GPIO4 = GPIO.addInstance();
if (system.getRTOS() === "tirtos7") {
    const tirtos7_release_syscfg_js = system.getScript("tirtos7_release.syscfg.js");
}
const UART  = scripting.addModule("/ti/drivers/UART2");
const UART1 = UART.addInstance();

/**
 * Write custom configuration values to the imported modules.
 */
GPIO1.$hardware         = system.deviceData.board.components.LED_RED;
GPIO1.$name             = "CONFIG_GPIO_LED_0";

GPIO2.$name             = "CONFIG_GPIO_LED_1";
GPIO2.$hardware         = system.deviceData.board.components.LED_GREEN;

GPIO3.$name             = "CONFIG_GPIO_BTN_0";
GPIO3.$hardware         = system.deviceData.board.components["BTN-1"];

GPIO4.$name             = "CONFIG_GPIO_BTN_1";
GPIO4.$hardware         = system.deviceData.board.components["BTN-2"];

UART1.$name             = "CONFIG_UART_0";
UART1.$hardware         = system.deviceData.board.components.XDS110UART;
